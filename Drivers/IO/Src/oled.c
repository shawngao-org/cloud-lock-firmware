//
// Created by ShawnGao on 2023/7/28.
//

#include "oled.h"

const unsigned char HEX_16[]=
{
        0x00,0xE0,0x10,0x08,0x08,0x10,0xE0,0x00,0x00,0x0F,0x10,0x20,0x20,0x10,0x0F,0x00,//0
        0x00,0x10,0x10,0xF8,0x00,0x00,0x00,0x00,0x00,0x20,0x20,0x3F,0x20,0x20,0x00,0x00,//1
        0x00,0x70,0x08,0x08,0x08,0x88,0x70,0x00,0x00,0x30,0x28,0x24,0x22,0x21,0x30,0x00,//2
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        0x08,0xF8,0x88,0x88,0xE8,0x08,0x10,0x00,0x20,0x3F,0x20,0x00,0x03,0x00,0x00,0x00,//F
};

const unsigned char FONT_8_16[] = {
        0x00,0x00,0x00,0x00,0x00,0x00,0x00,0x00,0x00,0x00,0x00,0x00,0x00,0x00,0x00,0x00, // 0
        0x00,0x00,0x00,0xF8,0x00,0x00,0x00,0x00,0x00,0x00,0x00,0x33,0x30,0x00,0x00,0x00, // ! 1
        0x00,0x10,0x0C,0x06,0x10,0x0C,0x06,0x00,0x00,0x00,0x00,0x00,0x00,0x00,0x00,0x00, //" 2
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        0x00,0x06,0x01,0x01,0x02,0x02,0x04,0x04,0x00,0x00,0x00,0x00,0x00,0x00,0x00,0x00, //~ 94
};

const unsigned char FONT_6_8[][6] = {
        0x00, 0x00, 0x00, 0x00, 0x00, 0x00, // sp
        0x00, 0x00, 0x00, 0x2f, 0x00, 0x00, // !
        0x00, 0x00, 0x07, 0x00, 0x07, 0x00, // "
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        0x14, 0x14, 0x14, 0x14, 0x14, 0x14, // horiz lines
};

const unsigned char ZH_CN[][16] = {
        {0x40,0x42,0xCC,0x00,0x00,0x44,0x54,0x54,0x54,0x7F,0x54,0x54,0x54,0x44,0x40,0x00},
        {0x00,0x00,0x7F,0x20,0x10,0x00,0xFF,0x15,0x15,0x15,0x55,0x95,0x7F,0x00,0x00,0x00},/* qing */
        {0x88,0x68,0x1F,0xC8,0x08,0x10,0xC8,0x54,0x52,0xD1,0x12,0x94,0x08,0xD0,0x10,0x00},
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        {0x80,0x60,0x1F,0x02,0x02,0x02,0x02,0x7F,0x02,0x02,0x42,0x82,0x7F,0x00,0x00,0x00},/* yong */
};

void OLED_I2C_ENABLE() {
    OLED_SCLK_SET();
    OLED_SDIN_SET();
    OLED_SDIN_CLR();
    OLED_SCLK_CLR();
}

void OLED_I2C_DISABLE() {
    OLED_SCLK_SET();
    OLED_SDIN_CLR();
    OLED_SDIN_SET();
}

void OLED_I2C_WAIT_ACK() {
    OLED_SCLK_SET();
    OLED_SCLK_CLR();
}

void OLED_WR_I2C_BYTE(unsigned char dat) {
    unsigned char i;
    unsigned char m, data;
    data = dat;
    OLED_SCLK_CLR();
    for (i = 0; i < 8; ++i) {
        m = data;
        m &= 0x80;
        if (m == 0x80) {
            OLED_SDIN_SET();
        } else {
            OLED_SDIN_CLR();
        }
        data <<= 1;
        OLED_SCLK_SET();
        OLED_SCLK_CLR();
    }
}

void OLED_WR_I2C_CMD_DATA(unsigned char dat, unsigned char mode) {
    OLED_I2C_ENABLE();
    OLED_WR_I2C_BYTE(0x78);
    OLED_I2C_WAIT_ACK();
    OLED_WR_I2C_BYTE(mode);
    OLED_I2C_WAIT_ACK();
    OLED_WR_I2C_BYTE(dat);
    OLED_I2C_WAIT_ACK();
    OLED_I2C_DISABLE();
}

void OLED_SET_POS(unsigned char x, unsigned char y) {
    OLED_WR_I2C_CMD_DATA(0xb0 + y, WR_CMD);
    OLED_WR_I2C_CMD_DATA(((x & 0xf0) >> 4) | 0x10, WR_CMD);
    OLED_WR_I2C_CMD_DATA((x & 0x0f), WR_CMD);
}

void OLED_DISPLAY_ENABLE() {
    OLED_WR_I2C_CMD_DATA(0x8d, WR_CMD);
    OLED_WR_I2C_CMD_DATA(0x14, WR_CMD);
    OLED_WR_I2C_CMD_DATA(0xaf, WR_CMD);
}

void OLED_DISPLAY_DISABLE() {
    OLED_WR_I2C_CMD_DATA(0x8d, WR_CMD);
    OLED_WR_I2C_CMD_DATA(0x10, WR_CMD);
    OLED_WR_I2C_CMD_DATA(0xae, WR_CMD);
}

void OLED_CLR() {
    unsigned char i, n;
    for (i = 0; i < 8; i++) {
        OLED_WR_I2C_CMD_DATA(0xb0 + i, WR_CMD);
        OLED_WR_I2C_CMD_DATA(0x00, WR_CMD);
        OLED_WR_I2C_CMD_DATA(0x10, WR_CMD);
        for (n = 0; n < 128; n++) {
            OLED_WR_I2C_CMD_DATA(0, WR_DATA);
        }
    }
}

void OLED_DISPLAY_CHAR(unsigned char x, unsigned char y, unsigned char c, unsigned char size) {
    unsigned char offset, i;
    offset = c - 32;
    if (x > MAX_COLUMN - 1) {
        x = 0; y += 2;
    }
    if (size == 16) {
        OLED_SET_POS(x, y);
        for (i = 0; i < 8; i++) {
            OLED_WR_I2C_CMD_DATA(FONT_8_16[offset * 16 + i], WR_DATA);
        }
        OLED_SET_POS(x, y + 1);
        for (i = 0; i < 8; i++) {
            OLED_WR_I2C_CMD_DATA(FONT_8_16[offset * 16 + i + 8], WR_DATA);
        }
    } else {
        OLED_SET_POS(x, y);
        for (i = 0; i < 6; i++) {
            OLED_WR_I2C_CMD_DATA(FONT_6_8[offset][i], WR_DATA);
        }
    }
}

void OLED_DISPLAY_STR(unsigned char x, unsigned char y, unsigned char* arr, unsigned char size) {
    while (*arr) {
        OLED_DISPLAY_CHAR(x, y, *(arr++), size);
        x += 8;
        if (x > 120) {
            x = 0; y += 2;
        }
        if (y > 6) {
            OLED_CLR();
            y = 0;
        }
    }
}

void OLED_DISPLAY_HEX(unsigned char x, unsigned char y, unsigned char hex) {
    char res[11] = {0};
    sprintf(res, "%02X", hex);
    OLED_DISPLAY_STR(x, y, (unsigned char *) res, 16);
}

void OLED_DISPLAY_ZH_CN(unsigned char x, unsigned char y, unsigned char index) {
    unsigned char i, addr = 0;
    OLED_SET_POS(x, y);
    for (i = 0; i < 16; i++) {
        OLED_WR_I2C_CMD_DATA(ZH_CN[2 * index][i], WR_DATA);
        addr++;
    }
    OLED_SET_POS(x, y + 1);
    for (i = 0; i < 16; i++) {
        OLED_WR_I2C_CMD_DATA(ZH_CN[2 * index + 1][i], WR_DATA);
        addr++;
    }
}

void OLED_INIT() {
    GPIO_InitTypeDef GPIO_InitStructure;

    __HAL_RCC_GPIOB_CLK_ENABLE();
    GPIO_InitStructure.Pin = GPIO_PIN_11 | GPIO_PIN_10;
    GPIO_InitStructure.Mode = GPIO_MODE_OUTPUT_PP;
    GPIO_InitStructure.Speed = GPIO_SPEED_FREQ_HIGH;
    HAL_GPIO_Init(GPIOB, &GPIO_InitStructure);
    HAL_GPIO_WritePin(GPIOB, GPIO_PIN_11 | GPIO_PIN_10, GPIO_PIN_SET);

    delay_ms(800);
    OLED_WR_I2C_CMD_DATA(0xAE, WR_CMD); /* --display off */
    OLED_WR_I2C_CMD_DATA(0x00, WR_CMD); /* ---set low column address */
    OLED_WR_I2C_CMD_DATA(0x10, WR_CMD); /* ---set high column address */
    OLED_WR_I2C_CMD_DATA(0x40, WR_CMD); /* --set start line address */
    OLED_WR_I2C_CMD_DATA(0xB0, WR_CMD); /* --set page address */
    OLED_WR_I2C_CMD_DATA(0x81, WR_CMD); /* contract control */
    OLED_WR_I2C_CMD_DATA(0xFF, WR_CMD); /* --128 */
    OLED_WR_I2C_CMD_DATA(0xA1, WR_CMD); /* set segment remap */
    OLED_WR_I2C_CMD_DATA(0xA6, WR_CMD); /* --normal / reverse */
    OLED_WR_I2C_CMD_DATA(0xA8, WR_CMD); /* --set multiplex ratio(1 to 64) */
    OLED_WR_I2C_CMD_DATA(0x3F, WR_CMD); /* --1/32 duty */
    OLED_WR_I2C_CMD_DATA(0xC8, WR_CMD); /* Com scan direction */
    OLED_WR_I2C_CMD_DATA(0xD3, WR_CMD); /* -set display offset */
    OLED_WR_I2C_CMD_DATA(0x00, WR_CMD); /*  */

    OLED_WR_I2C_CMD_DATA(0xD5, WR_CMD); /* set osc division */
    OLED_WR_I2C_CMD_DATA(0x80, WR_CMD); /*  */

    OLED_WR_I2C_CMD_DATA(0xD8, WR_CMD); /* set area color mode off */
    OLED_WR_I2C_CMD_DATA(0x05, WR_CMD); /*  */

    OLED_WR_I2C_CMD_DATA(0xD9, WR_CMD); /* Set Pre-Charge Period */
    OLED_WR_I2C_CMD_DATA(0xF1, WR_CMD); /*  */

    OLED_WR_I2C_CMD_DATA(0xDA, WR_CMD); /* set com pin config */
    OLED_WR_I2C_CMD_DATA(0x12, WR_CMD); /*  */

    OLED_WR_I2C_CMD_DATA(0xDB, WR_CMD); /* set Vcomh */
    OLED_WR_I2C_CMD_DATA(0x30, WR_CMD); /*  */

    OLED_WR_I2C_CMD_DATA(0x8D, WR_CMD); /* set charge pump enable */
    OLED_WR_I2C_CMD_DATA(0x14, WR_CMD); /*  */

    OLED_WR_I2C_CMD_DATA(0xAF, WR_CMD); /* --turn on oled panel */
}
